## dts/bindings/behaviors/zmk,behavior-bistable-toggle.yaml
```yaml
description: Set or toggle the global bistable slot (ZBS_SLOT_0, ZBS_SLOT_1, ZBS_TOG)

compatible: "zmk,behavior-bistable-toggle"

include: one_param.yaml
```

## dts/bindings/behaviors/zmk,behavior-bistable.yaml
```yaml
description: Bistable behavior - executes one of two bindings based on the current global slot

compatible: "zmk,behavior-bistable"

include: zero_param.yaml

properties:
  bindings:
    type: phandle-array
    required: true
```

## dts/bindings/input_processors/zmk,input-processor-bistable-scaler.yaml
```yaml
description: Bistable two-slot scaler with optional runtime-configurable slot

compatible: "zmk,input-processor-bistable-scaler"

include: ip_zero_param.yaml

properties:
  type:
    type: int
    required: true
  codes:
    type: array
    required: true
  slot0:
    type: int
    required: true
  slot1:
    type: int
    required: true
  default-coef:
    type: int
  default-coef-slot0:
    type: int
  default-coef-slot1:
    type: int
  zrc-prefix:
    type: string
    required: true
```

## src/Kconfig
```kconfig
config ZMK_BISTABLE_BEHAVIOR
    bool "Bistable Behavior"
    depends on SETTINGS
    default y

if ZMK_BISTABLE_BEHAVIOR

config ZMK_BISTABLE_BEHAVIOR_MAX_HELD
    int "Maximum simultaneously held bistable keys"
    default 8
    range 1 32

config ZMK_BISTABLE_BEHAVIOR_DEFAULT_SLOT
    int "Default bistable slot"
    default 0
    range 0 1

endif

rsource "behaviors/Kconfig"
rsource "pointing/Kconfig"
rsource "shell/Kconfig"
```

## src/behaviors/Kconfig
```kconfig
config ZMK_BEHAVIOR_BISTABLE
    bool "Bistable behavior"
    depends on ZMK_BISTABLE_BEHAVIOR
    default y

config ZMK_BEHAVIOR_BISTABLE_TOGGLE
    bool "Bistable toggle behavior"
    depends on ZMK_BISTABLE_BEHAVIOR
    default y
```

## src/pointing/Kconfig
```kconfig
config ZMK_INPUT_PROCESSOR_BISTABLE_SCALER
    bool "Bistable two-slot scaler input processor"
    depends on ZMK_BISTABLE_BEHAVIOR
    default y
```

## src/shell/Kconfig
```kconfig
if SHELL

config ZMK_BISTABLE_BEHAVIOR_SHELL
    bool "Bistable behavior shell commands"
    depends on ZMK_BISTABLE_BEHAVIOR
    default y

endif
```
